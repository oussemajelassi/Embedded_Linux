## BitBake_Manipulation/My_Layer/conf/bblayers.conf
```bitbake
BBLAYERS ?= "\
/home/flooki/Desktop/Embedded_Linux/BitBake_Manipulation/My_Layer \
" 
```

## BitBake_Manipulation/My_Layer/conf/layer.conf
```bitbake
BBPATH .= ":${LAYERDIR}"

BBFILES += "${LAYERDIR}/*.bb"

BBFILE_COLLECTIONS += "My_Layer"
BBFILE_PATTERN_My_Layer := "^${LAYERDIR}/"
```

## BitBake_Manipulation/conf/bblayers.conf
```bitbake
# POKY_BBLAYERS_CONF_VERSION is increased each time build/conf/bblayers.conf
# changes incompatibly
POKY_BBLAYERS_CONF_VERSION = "2"

BBPATH = "${TOPDIR}"
BBFILES ?= ""

BBLAYERS ?= " \
  /home/flooki/Desktop/Embedded_Linux/poky/meta \
  /home/flooki/Desktop/Embedded_Linux/poky/meta-poky \
  /home/flooki/Desktop/Embedded_Linux/poky/meta-yocto-bsp \
  "
```

## Flooki_Layer/conf/layer.conf
```bitbake
# We have a conf and classes directory, add to BBPATH
BBPATH .= ":${LAYERDIR}"

# We have recipes-* directories, add to BBFILES
BBFILES += "${LAYERDIR}/recipes-*/*/*.bb \
            ${LAYERDIR}/recipes-*/*/*.bbappend"

BBFILE_COLLECTIONS += "Flooki_Layer"
BBFILE_PATTERN_Flooki_Layer = "^${LAYERDIR}/"
BBFILE_PRIORITY_Flooki_Layer = "6"

LAYERDEPENDS_Flooki_Layer = "core"
LAYERSERIES_COMPAT_Flooki_Layer = "kirkstone langdale"
```

## meta-my-layer/conf/layer.conf
```bitbake
BBPATH .= ":${LAYERDIR}"
BBFILES += "${LAYERDIR}/recipes-*/*/*.bb ${LAYERDIR}/recipes-*/*/*.bbappend"
BBFILE_COLLECTIONS += "meta-my-layer"
BBFILE_PATTERN_meta-my-layer := "^${LAYERDIR}/"
BBFILE_PRIORITY_meta-my-layer = "6"
```
